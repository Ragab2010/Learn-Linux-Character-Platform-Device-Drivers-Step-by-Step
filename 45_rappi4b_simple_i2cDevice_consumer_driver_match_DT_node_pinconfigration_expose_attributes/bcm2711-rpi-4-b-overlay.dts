/dts-v1/;
/plugin/;

/ {
    compatible = "brcm,bcm2711";

    fragment@0 {
        target = <&i2c1>;
        __overlay__ {
            status = "okay";

            my_eeprom@50 {
                compatible = "ragab,myi2cdev";
                reg = <0x50>;      /* I2C address */
            };
        };
    };
};
