pseudo0: pseudo_char@1000 {
    compatible = "mycompany,pseudo-char";
    reg = <0x1000 0x100>;
    value = <111>;
    label = "Device_One";
};

pseudo1: pseudo_char@2000 {
    compatible = "mycompany,pseudo-char";
    reg = <0x2000 0x100>;
    value = <222>;
    label = "Device_Two";
};

pseudo2: pseudo_char@3000 {
    compatible = "mycompany,pseudo-char";
    reg = <0x3000 0x100>;
    value = <333>;
    label = "Device_Three";
};
